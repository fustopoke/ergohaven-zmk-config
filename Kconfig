## Kconfig
```kconfig
menuconfig K04_STATUS_LED
    bool "K:04 Mini single status LED widget"
    default y
    help
      Battery level, Bluetooth profile, and connection indications on the
      K:04 Mini onboard PWM LED, using blink counts and pace instead of
      colors. Requires the k04-status-led devicetree alias (defined in the
      k04_mini shield).

if K04_STATUS_LED

config LED
    default y

config PWM
    default y

config K04_STATUS_LED_INTERVAL_MS
    int "Gap between blink patterns in ms"
    default 300

config K04_STATUS_LED_BATTERY_BLINK_MS
    int "On/off duration of battery level blinks in ms"
    default 500

config K04_STATUS_LED_BATTERY_LEVEL_CRITICAL
    int "Critical battery percentage"
    default 10

config K04_STATUS_LED_CONN_SHOW_USB
    bool "Blink when USB transport is selected"
    default y

config K04_STATUS_LED_SHOW_LAYERS
    bool "Blink the highest active layer index on layer change"
    default n
    help
      N quick blinks when layer N becomes the highest active layer.
      Same pace as profile indications, so the two can be confused;
      profile blinks are always followed by a connection-status blink.

config K04_STATUS_LED_LAYER_DEBOUNCE_MS
    int "Debounce of layer change blinks in ms"
    default 250
    depends on K04_STATUS_LED_SHOW_LAYERS

endif # K04_STATUS_LED
```

## boards/shields/k04_mini/Kconfig.defconfig
```kconfig
if SHIELD_K04_MINI_LEFT

config ZMK_KEYBOARD_NAME
    default "EH K:04 Mini"

config ZMK_SPLIT_ROLE_CENTRAL
    default y

endif

if SHIELD_K04_MINI_LEFT || SHIELD_K04_MINI_RIGHT

config ZMK_SPLIT
    default y

config ZMK_POINTING
    default y

endif
```

## boards/shields/k04_mini/Kconfig.shield
```kconfig
config SHIELD_K04_MINI_LEFT
    def_bool $(shields_list_contains,k04_mini_left)

config SHIELD_K04_MINI_RIGHT
    def_bool $(shields_list_contains,k04_mini_right)
```
